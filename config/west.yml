## config/west.yml
```yaml
manifest:
  remotes:
    - name: zmkfirmware
      url-base: https://github.com/zmkfirmware
    - name: r-Keys-kbd
      url-base: https://github.com/10mega
    - name: caksoylar
      url-base: https://github.com/caksoylar
  projects:
    - name: zmk
      remote: zmkfirmware
      revision: main
      import: app/west.yml
    - name: zmk-pmw3610-driver
      remote: r-Keys-kbd
      revision: f23f7f76000c7fbfb080aca0fe8430b7023a9ab3
    - name: zmk-rgbled-widget
      remote: caksoylar
      revision: main
  self:
    path: config
```
